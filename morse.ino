#include <Morse.h>

Morse morse(13);
//定义一个数字存储每个字母的摩尔斯码
char a[26][4] = {
  {'.','-','*','*'},//A
  {'-','.','.','.'},//B
  {'-','.','-','.'},//C
  {'-','.','.','*'},//D
  {'.','*','*','*'},//E
  {'.','.','-','.'},//F
  {'-','-','.','*'},//G
  {'.','.','.','.'},//H
  {'.','.','*','*'},//I
  {'.','-','-','-'},//J
  {'-','.','-','*'},//K
  {'.','-','.','.'},//L
  {'-','-','*','*'},//M
  {'-','.','*','*'},//N
  {'-','-','-','*'},//O
  {'.','-','-','.'},//P
  {'-','-','.','-'},//Q
  {'.','-','.','*'},//R
  {'.','.','.','*'},//S
  {'-','*','*','*'},//T
  {'.','.','-','*'},//U
  {'.','.','.','-'},//V
  {'.','-','-','*'},//W
  {'-','.','.','-'},//X
  {'-','.','-','-'},//Y
  {'-','-','.','.'} //Z
};

void setup() 
{
  //打开串口
  Serial.begin(9600);
}

void loop()
{
  if (Serial.available() > 0)//判断是否有输入
  {
    int i = Serial.read();
    if (i>=97 && i<=122)//判断是否为字母
    {
      i -= 97;
      //根据摩尔斯码调用库函数控制led闪烁
      for (int j=0; j<4; ++j)
      {
        if (a[i][j]=='.')
            morse.dot();
        else if (a[i][j]=='-')
            morse.dash();
      }
      morse.c_space();//字符间的间隔
    }
    else if (i == 32)
        morse.w_space();//读取到空格时单词间的间隔
    else
        morse.s_space();//读取到回车时句子间的间隔
  }
}
